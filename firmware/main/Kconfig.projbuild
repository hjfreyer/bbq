## firmware/main/Kconfig.projbuild
```kconfig
menu "BBQ Configuration"

    config EXAMPLE_FIRMWARE_UPGRADE_URL
        string "firmware upgrade url endpoint"
        default "https://192.168.0.3:8070/hello_world.bin"
        help
            URL of server which hosts the firmware
            image.

    config EXAMPLE_USE_CERT_BUNDLE
        bool "Enable certificate bundle"
        default y
        depends on MBEDTLS_CERTIFICATE_BUNDLE
        help
            Enable trusted root certificate bundle. This approach allows to have
            OTA updates functional with any public server without requirement
            to explicitly add its server certificate.

    config EXAMPLE_SKIP_COMMON_NAME_CHECK
        bool "Skip server certificate CN fieldcheck"
        default n
        help
            This allows you to skip the validation of OTA server certificate CN field.


    config BROKER_URI
        string "Broker URL"
        default "mqtts://25892ce13ca54f009b10ee48603654a5.s2.eu.hivemq.cloud:8883"
        help
            URL of an mqtt broker which this example connects to.

    config BROKER_BIN_SIZE_TO_SEND
        # This option is not visible and is used only to set parameters for example tests
        # Here we configure the data size to send and to be expected in the python script
        int
        default 20000

    config BROKER_USERNAME
        string "Broker Username"
        default ""

    config BROKER_PASSWORD
        string "Broker Password"
        default ""
    
endmenu
```

## main/Kconfig.projbuild
```kconfig
menu "BBQ Configuration"
    config PROBE1_GPIO
        int "GPIO for probe 1 ADC"
        range 32 39
        default 35

    config PROBE2_GPIO
        int "GPIO for probe 2 ADC"
        range 32 39
        default 36
                                   
    config VREF_GPIO
        int "GPIO for the reference voltage reading ADC"
        range 32 39
        default 34

    config PROBE_RESISTOR_OHMS
        int "Value of the resistor connected to the probe, in ohms"
        default 10000
        
    config FAN_CONTROL_GPIO
        int "GPIO to control the fan"
        range 0 48
        default 27
                
    config TICK_PERIOD
        int "Tick duration in milliseconds"
        range 10 3600000
        default 100

    config DUTY_PERIOD
        int "Duty cycle length in ticks"
        range 10 100000
        default 100

    config REPORT_PERIOD
        int "Report period in ticks"
        range 1 3600000
        default 50

    config DATA_ENDPOINT
        string "URL to push data"
        default "https://bbqbe.hjfreyer.repl.co/device/data"

    config INITIAL_THRESHOLD
        int "Initial threshold (deg F)"
        default 225
endmenu
```
